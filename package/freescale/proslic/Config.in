## package/freescale/proslic/Config.in
```kconfig
menu "ProSLIC module options"
	depends on PACKAGE_kmod-proslic

	choice 
		prompt "Select chipset/BOM option to use"
		default SI3227_FB
		help
			Select which chipset/BOM option to build for.  If unsure, please contact your hardware supplier.

		config SI3227_FB
			bool "SI3227 Flyback"

		config SI3215
			bool "SI3215"

		config SI3217X_FB
			bool "SI3217X Flyback"

		config SI3217X_PBB
			bool "SI3217X PMOS-BuckBoost"

		config SI3226X_FB
			bool "SI3226X Flyback"

		config SI3226X_TSS
			bool "SI3226X TSS"

		config SI3226X_TSS_ISO
			bool "SI3226X TSS ISO"
        
	        config SI3226X_PBB
        		bool "SI3226X PMOS-BuckBoost"

        	config SI3226X_PBB_JPN
        		bool "SI3226X PMOS-BuckBoost - Japan"

	endchoice

	config SILABS_DEBUG
		bool "Enable debugging"
		default n
        help
            Select this option if you wish to have additional debug messages included in the build.

	config SILABS_PROC_DEBUG
		bool "Enable proc entry debugging"
		default n
        help
            Select this option if you wish to have peek/poke cabilities.  Not supported by all chipsets.

    config SILABS_SPITEST
        bool "Enable in the proc entry a SPI test routine"
        default n
        help
            Select thsi option if you wish to have a pattern test generator sending data to/from the ProSLIC chipset.  NOT recommended with
            production setups. Not supported by all chipsets.
endmenu
```

## package/openwrt/net/samba4/Config.in
```kconfig
#
# Copyright (C) 2012 Mindspeed Technologies
#
# This is free software, licensed under the GNU General Public License v2.
# See /LICENSE for more information.
#

if PACKAGE_samba4-server
config PACKAGE_SAMBA4_MAX_DEBUG_LEVEL
	int "Maximum level of compiled-in debug messages"
	default -1
config PACKAGE_SAMBA4_SMB_SPLICE
	bool "Mindspeed SMB Splice support"
	default y
endif
```

## target/linux/Config.in
```kconfig
#
choice
	prompt "Linux Kernel Version" if DEVEL
	default LINUX_3_2

config LINUX_3_2
	bool "Linux Kernel 3.2"
	help
	  Select Linux Kernel 3.2 

config LINUX_3_19
	bool "Linux Kernel 3.19"
	help
	  Select Linux Kernel 3.19
endchoice
```

## target/linux/comcerto2000/Config.in
```kconfig
config COMCERTO_PAGE_SIZE_64K
	bool "Compile kernel with 64kB page size"
	default y
	depends TARGET_comcerto2000_nas || TARGET_comcerto2000_hgw_nas
	help
	   If set, the Linux kernel will be compiled with a 64kB page size If disabled, the regular 4kB page size will be used.
```

## target/linux/comcerto2000/image/Config.in
```kconfig
config TARGET_COMCERTO_RAMDISK
	bool
	prompt "Generate comcerto ramdisk image"
	default n
	select BUSYBOX_CONFIG_UBIATTACH
	select BUSYBOX_CONFIG_UBIDETACH
	select BUSYBOX_CONFIG_UBIMKVOL
	select BUSYBOX_CONFIG_UBIRMVOL
	select BUSYBOX_CONFIG_UBIRSVOL
	select BUSYBOX_CONFIG_UBIUPDATEVOL
	help
	  SDK generates comcerto ram disk image.

config TARGET_COMCERTO_MULTI_IMAGE
	bool "Generate comcerto multi-image uImage"
	default y
	depends on TARGET_COMCERTO_RAMDISK
	help
	  Combine zImage and ramdisk into a single uImage
```
